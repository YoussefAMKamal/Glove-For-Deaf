#include "ADC_Private.h"

void ADC_Init(ADC_Prescaler Prescaler, ADC_Vref Vref)
{
	switch(Vref)
	{
		case Aref:
		CLR_BIT(ADMUX,REFS1); CLR_BIT(ADMUX,REFS0);
		break;
		case Avcc:
		CLR_BIT(ADMUX,REFS1); SET_BIT(ADMUX,REFS0);
		break;
		case A_Internal:
		SET_BIT(ADMUX,REFS1); SET_BIT(ADMUX,REFS0);
		break;
	}
	switch(Prescaler)
	{
		case ADC_Pre1:
		CLR_BIT(ADCSRA,ADPS2);		CLR_BIT(ADCSRA,ADPS1);		CLR_BIT(ADCSRA,ADPS0);
		break;
		case ADC_Pre2:
		CLR_BIT(ADCSRA,ADPS2);		CLR_BIT(ADCSRA,ADPS1);		SET_BIT(ADCSRA,ADPS0);
		break;
		case ADC_Pre4:
		CLR_BIT(ADCSRA,ADPS2);		SET_BIT(ADCSRA,ADPS1);		CLR_BIT(ADCSRA,ADPS0);
		break;
		case ADC_Pre8:
		CLR_BIT(ADCSRA,ADPS2);		SET_BIT(ADCSRA,ADPS1);		SET_BIT(ADCSRA,ADPS0);
		break;
		case ADC_Pre16:
		SET_BIT(ADCSRA,ADPS2);		CLR_BIT(ADCSRA,ADPS1);		CLR_BIT(ADCSRA,ADPS0);
		break;
		case ADC_Pre32:
		SET_BIT(ADCSRA,ADPS2);		CLR_BIT(ADCSRA,ADPS1);		SET_BIT(ADCSRA,ADPS0);
		break;
		case ADC_Pre64:
		SET_BIT(ADCSRA,ADPS2);		SET_BIT(ADCSRA,ADPS1);		CLR_BIT(ADCSRA,ADPS0);
		break;
		case ADC_Pre128:
		SET_BIT(ADCSRA,ADPS2);		SET_BIT(ADCSRA,ADPS1);		SET_BIT(ADCSRA,ADPS0);
		break;
	}
	CLR_BIT(ADMUX,ADLAR);
	SET_BIT(ADCSRA,ADEN);	CLR_BIT(ADCSRA,ADATE);	CLR_BIT(ADCSRA,ADIE);
}

uint16_t ADC_Read(ADC_Channel Channel)
{
	uint16_t Read = 0;
	switch(Channel)
	{
		case ADC0_Ch:
		CLR_BIT(ADMUX,MUX4);	CLR_BIT(ADMUX,MUX3);	CLR_BIT(ADMUX,MUX2);	CLR_BIT(ADMUX,MUX1);	CLR_BIT(ADMUX,MUX0);
		break;
		case ADC1_Ch:
		CLR_BIT(ADMUX,MUX4);	CLR_BIT(ADMUX,MUX3);	CLR_BIT(ADMUX,MUX2);	CLR_BIT(ADMUX,MUX1);	SET_BIT(ADMUX,MUX0);
		break;
		case ADC2_Ch:
		CLR_BIT(ADMUX,MUX4);	CLR_BIT(ADMUX,MUX3);	CLR_BIT(ADMUX,MUX2);	SET_BIT(ADMUX,MUX1);	CLR_BIT(ADMUX,MUX0);
		break;
		case ADC3_Ch:
		CLR_BIT(ADMUX,MUX4);	CLR_BIT(ADMUX,MUX3);	CLR_BIT(ADMUX,MUX2);	SET_BIT(ADMUX,MUX1);	SET_BIT(ADMUX,MUX0);
		break;
		case ADC4_Ch:
		CLR_BIT(ADMUX,MUX4);	CLR_BIT(ADMUX,MUX3);	SET_BIT(ADMUX,MUX2);	CLR_BIT(ADMUX,MUX1);	CLR_BIT(ADMUX,MUX0);
		break;
		case ADC5_Ch:
		CLR_BIT(ADMUX,MUX4);	CLR_BIT(ADMUX,MUX3);	SET_BIT(ADMUX,MUX2);	CLR_BIT(ADMUX,MUX1);	SET_BIT(ADMUX,MUX0);
		break;
		case ADC6_Ch:
		CLR_BIT(ADMUX,MUX4);	CLR_BIT(ADMUX,MUX3);	SET_BIT(ADMUX,MUX2);	SET_BIT(ADMUX,MUX1);	CLR_BIT(ADMUX,MUX0);
		break;
		case ADC7_Ch:
		CLR_BIT(ADMUX,MUX4);	CLR_BIT(ADMUX,MUX3);	SET_BIT(ADMUX,MUX2);	SET_BIT(ADMUX,MUX1);	SET_BIT(ADMUX,MUX0);
		break;
	}
	SET_BIT(ADCSRA,ADSC);
	while(GET_BIT(ADCSRA,ADIF) != 1);
	SET_BIT(ADCSRA,ADIF);
	Read = ADC_Data;
	return Read;
}